## components/esp_bms_lvgl_bridge/Kconfig
```kconfig
menu "ESP BMS LVGL Bridge"

    config ESP_BMS_LVGL_BRIDGE_BACKLIGHT_DIMMING
        bool "Enable backlight dimming"
        default y
        help
            Enable the brightness controls and backlight PWM implementation.
            XL9555 boards use software PWM; boards with a dedicated backlight
            GPIO use LEDC hardware PWM. When disabled, the backlight stays on
            and brightness controls are omitted from the device UI.

    config ESP_BMS_LVGL_BRIDGE_SPI_DRAW_BUFFER_HEIGHT
        int "SPI draw buffer height"
        range 10 120
        default 64
        help
            Draw buffer height in display rows for the ESP LVGL adapter SPI
            display path. Larger values reduce visible row-band refresh during
            whole-page drags, but consume more internal DMA-capable RAM.

            At 320 px wide and RGB565, 64 rows use about 40 KiB for the single
            partial-mode draw buffer. Keep this below a full frame on ESP32
            without PSRAM.

            This is ignored while ESP_BMS_LVGL_BRIDGE_FULL_REFRESH_DOUBLE_BUFFER
            is active (16-bit I80 with PSRAM), which renders full frames instead.

    config ESP_BMS_LVGL_BRIDGE_TASK_MAX_DELAY_MS
        int "LVGL adapter task max delay"
        range 1 15
        default 5
        help
            Maximum sleep interval for the ESP LVGL adapter worker task in
            milliseconds. Lower values improve touch-following latency at the
            cost of more frequent LVGL work.

    config ESP_BMS_LVGL_BRIDGE_DOUBLE_BUFFER
        bool "Use two LVGL SPI draw buffers"
        default y if SPIRAM
        default n
        help
            Allocate a secondary SPI draw buffer for the ESP LVGL adapter
            partial render mode. This can improve overlap between rendering and
            SPI/I80 flush work during page drags. On PSRAM targets this is
            enabled by default and consumes external RAM; the bridge enables it
            only when two buffers fit. At 320 px wide and 64 rows it costs
            another about 40 KiB.

            Keep this disabled in normal images without PSRAM until hardware
            logs confirm enough free internal RAM remains after LVGL, Wi-Fi,
            and HTTP start. Explicit diagnostic configurations can still enable
            it for A/B testing on those targets.

            On 16-bit I80 boards with PSRAM this is superseded by
            ESP_BMS_LVGL_BRIDGE_FULL_REFRESH_DOUBLE_BUFFER, which renders one
            full-screen buffer per frame instead of a partial-refresh pair.

    config ESP_BMS_LVGL_BRIDGE_FULL_REFRESH_DOUBLE_BUFFER
        bool "Full-frame refresh with PSRAM (16-bit I80)"
        default n
        help
            Use a full-screen PSRAM draw buffer on 16-bit I80 panels (e.g.
            ST7796 on ESP32-S3) when PSRAM can hold a full-screen RGB565
            buffer.

            Every frame renders into the full-screen buffer and the panel
            updates in a sweep of back-to-back transfers. This removes the
            visible row-band refresh ("the picture moves in bands") during page
            drags and carousel transitions.

            The frame still travels through internal DMA bounce buffers, in
            chunks of LVGL_FULL_FRAME_CHUNK_ROWS rows: the I80 DMA cannot read a
            PSRAM draw buffer reliably and shows garbage on the panel. The draw
            callback swaps the RGB565 bytes while copying, so the submitted wire
            order matches the partial-refresh path.

            Two bounce buffers rotate, so copying chunk N+1 overlaps the transfer
            of chunk N, and LVGL keeps two full-screen draw buffers so it can
            start the next frame while the last chunk drains. Total internal DMA
            RAM is the same as the single larger bounce buffer it replaces; the
            extra LVGL buffer costs one more full-screen PSRAM allocation.

            The adapter's DOUBLE_FULL and TRIPLE_FULL tear-avoidance modes stay
            unused: they are RGB/MIPI-only and need panel frame buffers. The
            option name is kept for backward compatibility.

            Requires PSRAM. On SPI panels, 8-bit I80, or targets without PSRAM
            this option has no effect and the partial-refresh path is used.

    config ESP_BMS_LVGL_BRIDGE_SKIP_RGB565_SWAP
        bool "Record the 16-bit I80 wire order (no effect on the draw path)"
        default y if IDF_TARGET_ESP32S3
        default n
        help
            Records that the display uses a 16-bit parallel I80 bus, where each
            pixel is one atomic 16-bit transfer, instead of an 8-bit SPI/I80 bus
            that shifts bytes out sequentially.

            The byte order is not selected here: esp_bms_lvgl_bridge installs its
            own draw-bitmap callback, which performs the RGB565 byte swap on both
            the partial and the full-frame I80 path. This option only keeps the
            documented convention for existing sdkconfig files.

            This project's ESP32-S3 boards use a 16-bit I80 panel (ST7796);
            classic ESP32 boards use an 8-bit SPI panel (ST7789).

endmenu
```

## config/sdkconfig/sdkconfig.defaults.esp32c3
```kconfig
CONFIG_FREERTOS_HZ=1000
CONFIG_FREERTOS_USE_TRACE_FACILITY=y
CONFIG_FREERTOS_GENERATE_RUN_TIME_STATS=y
CONFIG_ESPTOOLPY_FLASHSIZE_4MB=y
CONFIG_ESPTOOLPY_FLASHSIZE="4MB"
CONFIG_PARTITION_TABLE_CUSTOM=y
CONFIG_PARTITION_TABLE_CUSTOM_FILENAME="partitions.csv"
CONFIG_PARTITION_TABLE_FILENAME="partitions.csv"
CONFIG_ESP_DEFAULT_CPU_FREQ_MHZ_160=y
CONFIG_BT_ENABLED=y
CONFIG_BT_NIMBLE_ENABLED=y
CONFIG_BT_NIMBLE_50_FEATURE_SUPPORT=y
CONFIG_BT_NIMBLE_LL_CFG_FEAT_LE_CODED_PHY=y
CONFIG_BT_NIMBLE_ROLE_CENTRAL=y
CONFIG_BT_NIMBLE_ROLE_PERIPHERAL=y
CONFIG_BT_NIMBLE_ROLE_BROADCASTER=y
CONFIG_BT_NIMBLE_ROLE_OBSERVER=y
CONFIG_BT_NIMBLE_GATT_CLIENT=y
CONFIG_BT_NIMBLE_GATT_SERVER=y
CONFIG_BT_NIMBLE_SECURITY_ENABLE=y
CONFIG_BT_NIMBLE_SM_SC=y
CONFIG_BT_NIMBLE_NVS_PERSIST=y
CONFIG_LWIP_MAX_SOCKETS=8
CONFIG_LWIP_DHCPS_MAX_STATION_NUM=1
CONFIG_LV_CONF_SKIP=y
CONFIG_LV_CONF_MINIMAL=y
CONFIG_LV_TXT_ENC_UTF8=y
CONFIG_LV_COLOR_DEPTH_16=y
CONFIG_LV_COLOR_DEPTH=16
CONFIG_LV_OS_FREERTOS=y
CONFIG_LV_USE_FREERTOS_TASK_NOTIFY=y
CONFIG_LV_DRAW_SW_DRAW_UNIT_CNT=1
CONFIG_LV_USE_CLIB_MALLOC=y
CONFIG_LV_USE_CLIB_STRING=y
CONFIG_LV_USE_CLIB_SPRINTF=y
CONFIG_LV_DEF_REFR_PERIOD=20
# CONFIG_LV_OBJ_STYLE_CACHE is not set
CONFIG_LV_DRAW_SW_SUPPORT_RGB565=y
CONFIG_LV_DRAW_SW_SUPPORT_RGB565_SWAPPED=y
# CONFIG_LV_DRAW_SW_SUPPORT_RGB565A8 is not set
# CONFIG_LV_DRAW_SW_SUPPORT_RGB888 is not set
# CONFIG_LV_DRAW_SW_SUPPORT_XRGB8888 is not set
CONFIG_LV_DRAW_SW_SUPPORT_ARGB8888=y
# CONFIG_LV_DRAW_SW_SUPPORT_ARGB8888_PREMULTIPLIED is not set
# CONFIG_LV_DRAW_SW_SUPPORT_L8 is not set
# CONFIG_LV_DRAW_SW_SUPPORT_AL88 is not set
CONFIG_LV_DRAW_SW_SUPPORT_A8=y
CONFIG_LV_DRAW_SW_SUPPORT_I1=y
CONFIG_LV_DRAW_LAYER_SIMPLE_BUF_SIZE=8192
CONFIG_LV_MEM_SIZE_KILOBYTES=48
CONFIG_LV_FONT_MONTSERRAT_14=y
CONFIG_LV_FONT_MONTSERRAT_24=y
CONFIG_LV_FONT_MONTSERRAT_28=y
CONFIG_LV_FONT_MONTSERRAT_48=y
CONFIG_LV_FONT_DEFAULT_MONTSERRAT_14=y
CONFIG_LV_USE_LABEL=y
CONFIG_LV_USE_CANVAS=y
CONFIG_LV_USE_ARC=y
CONFIG_LV_USE_IMAGE=y
CONFIG_LV_USE_LINE=y
CONFIG_LV_USE_ROLLER=y
# CONFIG_LV_USE_DROPDOWN is not set
# CONFIG_LV_USE_BAR is not set
# CONFIG_LV_USE_BUTTON is not set
# CONFIG_LV_USE_BUTTONMATRIX is not set
# CONFIG_LV_USE_CALENDAR is not set
# CONFIG_LV_USE_CHART is not set
# CONFIG_LV_USE_CHECKBOX is not set
# CONFIG_LV_USE_IMAGEBUTTON is not set
# CONFIG_LV_USE_KEYBOARD is not set
# CONFIG_LV_USE_LED is not set
# CONFIG_LV_USE_LIST is not set
# CONFIG_LV_USE_MENU is not set
# CONFIG_LV_USE_MSGBOX is not set
# CONFIG_LV_USE_SCALE is not set
# CONFIG_LV_USE_SLIDER is not set
# CONFIG_LV_USE_SPAN is not set
# CONFIG_LV_USE_SPINBOX is not set
# CONFIG_LV_USE_SPINNER is not set
# CONFIG_LV_USE_SWITCH is not set
# CONFIG_LV_USE_TABLE is not set
# CONFIG_LV_USE_TABVIEW is not set
# CONFIG_LV_USE_TEXTAREA is not set
# CONFIG_LV_USE_TILEVIEW is not set
# CONFIG_LV_USE_WIN is not set
# CONFIG_LV_USE_ANIMIMG is not set
# CONFIG_LV_USE_ARCLABEL is not set
CONFIG_LV_USE_FLEX=y
# CONFIG_LV_USE_GRID is not set
# CONFIG_LV_USE_OBSERVER is not set
# CONFIG_LV_USE_THEME_DEFAULT is not set
# CONFIG_LV_USE_THEME_SIMPLE is not set
CONFIG_LV_USE_QRCODE=y
# CONFIG_LV_BUILD_EXAMPLES is not set
# CONFIG_LV_BUILD_DEMOS is not set
CONFIG_ESP_BMS_LVGL_BRIDGE_SPI_DRAW_BUFFER_HEIGHT=28
CONFIG_ESP_BMS_LVGL_BRIDGE_TASK_MAX_DELAY_MS=5
CONFIG_HTTPD_WS_SUPPORT=y
CONFIG_HTTPD_WS_PRE_HANDSHAKE_CB_SUPPORT=y
CONFIG_HTTPD_WS_POST_HANDSHAKE_CB_SUPPORT=y
```

## config/sdkconfig/sdkconfig.defaults.esp32p4
```kconfig
CONFIG_FREERTOS_HZ=1000
CONFIG_FREERTOS_USE_TRACE_FACILITY=y
CONFIG_FREERTOS_GENERATE_RUN_TIME_STATS=y
CONFIG_ESPTOOLPY_FLASHSIZE_16MB=y
CONFIG_ESPTOOLPY_FLASHSIZE="16MB"
CONFIG_PARTITION_TABLE_CUSTOM=y
CONFIG_PARTITION_TABLE_CUSTOM_FILENAME="partitions.csv"
CONFIG_PARTITION_TABLE_FILENAME="partitions.csv"
# ESP32-P4 has neither an integrated Wi-Fi radio nor Bluetooth controller.
CONFIG_LWIP_MAX_SOCKETS=8
CONFIG_LV_CONF_SKIP=y
CONFIG_LV_CONF_MINIMAL=y
CONFIG_LV_TXT_ENC_UTF8=y
CONFIG_LV_COLOR_DEPTH_16=y
CONFIG_LV_COLOR_DEPTH=16
CONFIG_LV_OS_FREERTOS=y
CONFIG_LV_USE_FREERTOS_TASK_NOTIFY=y
CONFIG_LV_USE_CLIB_MALLOC=y
CONFIG_LV_USE_CLIB_STRING=y
CONFIG_LV_USE_CLIB_SPRINTF=y
CONFIG_LV_DEF_REFR_PERIOD=10
CONFIG_LV_DRAW_SW_SUPPORT_RGB565=y
CONFIG_LV_DRAW_SW_SUPPORT_RGB565_SWAPPED=y
CONFIG_LV_DRAW_SW_SUPPORT_ARGB8888=y
CONFIG_LV_DRAW_SW_SUPPORT_A8=y
CONFIG_LV_DRAW_SW_SUPPORT_I1=y
CONFIG_LV_FONT_MONTSERRAT_14=y
CONFIG_LV_FONT_MONTSERRAT_24=y
CONFIG_LV_FONT_MONTSERRAT_28=y
CONFIG_LV_FONT_MONTSERRAT_48=y
CONFIG_LV_FONT_DEFAULT_MONTSERRAT_14=y
CONFIG_LV_USE_LABEL=y
CONFIG_LV_USE_CANVAS=y
CONFIG_LV_USE_ARC=y
CONFIG_LV_USE_DROPDOWN=y
CONFIG_LV_USE_ROLLER=y
CONFIG_LV_USE_LINE=y
CONFIG_LV_USE_IMAGE=y
CONFIG_LV_USE_QRCODE=y
CONFIG_ESP_BMS_LVGL_BRIDGE_SPI_DRAW_BUFFER_HEIGHT=40
CONFIG_ESP_BMS_LVGL_BRIDGE_TASK_MAX_DELAY_MS=5
CONFIG_HTTPD_WS_SUPPORT=y
CONFIG_HTTPD_WS_PRE_HANDSHAKE_CB_SUPPORT=y
CONFIG_HTTPD_WS_POST_HANDSHAKE_CB_SUPPORT=y
```
