## components/esp_bms_lvgl_ui/Kconfig
```kconfig
menu "ESP BMS LVGL UI"

    config ESP_BMS_LVGL_UI_DRAG_FULL_INVALIDATE
        bool "Invalidate full dashboard viewport while page scrolling"
        default y
        help
            Invalidate the entire dashboard viewport after page x-position
            changes during LVGL native horizontal scroll and snap animations.
            This makes moving pages redraw as one surface instead of letting
            individual labels/widgets refresh in separate invalidation chunks.

            Disable this only when hardware logs show the extra redraw work
            causes worse latency than the partial-object invalidation path.

    config ESP_BMS_LVGL_UI_DRAG_DIAGNOSTICS
        bool "Enable LVGL page scroll diagnostics"
        default n
        help
            Log dashboard page scroll begin/end boundary events.
            Keep this disabled for normal images because serial logging changes
            the touch-following behavior being measured.

    config ESP_BMS_LVGL_UI_DRAG_SAMPLE_DIAGNOSTICS
        bool "Enable LVGL page scroll sample diagnostics"
        default n
        depends on ESP_BMS_LVGL_UI_DRAG_DIAGNOSTICS
        help
            Log low-rate LV_EVENT_SCROLL samples while a dashboard page is
            scrolled. This helps diagnose touch sampling gaps and scroll-position
            jumps on hardware, but should stay disabled for normal images.

    config ESP_BMS_LVGL_UI_DRAG_SAMPLE_PERIOD_MS
        int "LVGL page scroll sample diagnostic period"
        range 20 1000
        default 100
        depends on ESP_BMS_LVGL_UI_DRAG_SAMPLE_DIAGNOSTICS
        help
            Minimum interval between scroll sample diagnostic log lines.

endmenu
```

## sdkconfig.defaults
```kconfig
CONFIG_FREERTOS_HZ=1000

CONFIG_ESPTOOLPY_FLASHSIZE_4MB=y
CONFIG_ESPTOOLPY_FLASHSIZE="4MB"
CONFIG_PARTITION_TABLE_CUSTOM=y
CONFIG_PARTITION_TABLE_CUSTOM_FILENAME="partitions.csv"
CONFIG_PARTITION_TABLE_FILENAME="partitions.csv"
CONFIG_ESP32_REV_MIN_3=y
CONFIG_ESP32_REV_MIN=3
CONFIG_ESP32_REV_MIN_FULL=300
CONFIG_ESP_REV_MIN_FULL=300
CONFIG_BT_ENABLED=y
CONFIG_BT_NIMBLE_ENABLED=y
# ESP32-WROOM-32E has no external PSRAM. Keep this disabled so boot does not
# probe missing hardware and all memory budgets reflect internal SRAM only.
# CONFIG_SPIRAM is not set
# CONFIG_BT_NIMBLE_MEM_ALLOC_MODE_INTERNAL is not set
# CONFIG_BT_NIMBLE_MEM_ALLOC_MODE_EXTERNAL is not set
CONFIG_BT_NIMBLE_MEM_ALLOC_MODE_DEFAULT=y
CONFIG_BTDM_CTRL_BLE_MAX_CONN=3
# CONFIG_BTDM_CTRL_MODEM_SLEEP is not set
# CONFIG_BTDM_CTRL_FULL_SCAN_SUPPORTED is not set
# CONFIG_ESP_WIFI_IRAM_OPT is not set
# CONFIG_ESP_WIFI_RX_IRAM_OPT is not set
CONFIG_ESP_WIFI_STATIC_RX_BUFFER_NUM=6
CONFIG_ESP_WIFI_DYNAMIC_RX_BUFFER_NUM=12
CONFIG_ESP_WIFI_DYNAMIC_TX_BUFFER_NUM=12
CONFIG_ESP_WIFI_RX_MGMT_BUF_NUM_DEF=3
CONFIG_ESP_WIFI_MGMT_SBUF_NUM=12
# Setup AP is WPA2-PSK only; station, enterprise, and WPA3-only code paths are unused.
# CONFIG_ESP_WIFI_ENABLE_WPA3_SAE is not set
# CONFIG_ESP_WIFI_ENABLE_SAE_PK is not set
# CONFIG_ESP_WIFI_ENABLE_SAE_H2E is not set
# CONFIG_ESP_WIFI_SOFTAP_SAE_SUPPORT is not set
# CONFIG_ESP_WIFI_ENABLE_WPA3_OWE_STA is not set
# CONFIG_ESP_WIFI_ENTERPRISE_SUPPORT is not set
CONFIG_LWIP_MAX_SOCKETS=8
CONFIG_LWIP_DHCPS_MAX_STATION_NUM=1
CONFIG_LWIP_TCPIP_RECVMBOX_SIZE=12
CONFIG_LWIP_MAX_ACTIVE_TCP=6
CONFIG_LWIP_MAX_LISTENING_TCP=4
CONFIG_LWIP_MAX_UDP_PCBS=6
CONFIG_LWIP_MAX_RAW_PCBS=4
CONFIG_BT_NIMBLE_ROLE_CENTRAL=y
CONFIG_BT_NIMBLE_ROLE_PERIPHERAL=y
CONFIG_BT_NIMBLE_ROLE_BROADCASTER=y
CONFIG_BT_NIMBLE_ROLE_OBSERVER=y
CONFIG_BT_NIMBLE_GATT_CLIENT=y
CONFIG_BT_NIMBLE_GATT_SERVER=y
# CONFIG_BT_NIMBLE_SECURITY_ENABLE is not set
CONFIG_BT_NIMBLE_MAX_CONNECTIONS=3
CONFIG_LV_USE_ROLLER=y
CONFIG_BT_NIMBLE_MAX_CCCDS=4
CONFIG_BT_NIMBLE_ATT_PREFERRED_MTU=128
CONFIG_BT_NIMBLE_ATT_MAX_PREP_ENTRIES=4
CONFIG_BT_NIMBLE_GATT_MAX_PROCS=2
CONFIG_BT_NIMBLE_MSYS_1_BLOCK_COUNT=8
CONFIG_BT_NIMBLE_MSYS_2_BLOCK_COUNT=12
CONFIG_BT_NIMBLE_TRANSPORT_ACL_FROM_LL_COUNT=12
CONFIG_BT_NIMBLE_TRANSPORT_EVT_COUNT=16
CONFIG_BT_NIMBLE_TRANSPORT_EVT_DISCARD_COUNT=4
# GAP supplies the device name and advertising. The product uses no optional
# standard GATT services, only its existing central/peripheral protocol.
# CONFIG_BT_NIMBLE_PROX_SERVICE is not set
# CONFIG_BT_NIMBLE_ANS_SERVICE is not set
# CONFIG_BT_NIMBLE_CTS_SERVICE is not set
# CONFIG_BT_NIMBLE_HTP_SERVICE is not set
# CONFIG_BT_NIMBLE_IPSS_SERVICE is not set
# CONFIG_BT_NIMBLE_TPS_SERVICE is not set
# CONFIG_BT_NIMBLE_IAS_SERVICE is not set
# CONFIG_BT_NIMBLE_LLS_SERVICE is not set
# CONFIG_BT_NIMBLE_SPS_SERVICE is not set
# CONFIG_BT_NIMBLE_HR_SERVICE is not set
# CONFIG_BT_NIMBLE_BAS_SERVICE is not set
# CONFIG_BT_NIMBLE_DIS_SERVICE is not set
# CONFIG_BT_NIMBLE_DTM_MODE_TEST is not set

# SoftAP plus LVGL uses the 4 MB custom dual app-slot partition layout.
CONFIG_COMPILER_OPTIMIZATION_SIZE=y
# CONFIG_COMPILER_OPTIMIZATION_DEBUG is not set
CONFIG_COMPILER_OPTIMIZATION_ASSERTIONS_SILENT=y
# CONFIG_COMPILER_OPTIMIZATION_ASSERTIONS_ENABLE is not set
CONFIG_LIBC_NEWLIB_NANO_FORMAT=y

CONFIG_LV_CONF_SKIP=y
CONFIG_LV_CONF_MINIMAL=y
CONFIG_LV_COLOR_DEPTH_16=y
CONFIG_LV_COLOR_DEPTH=16
CONFIG_LV_OS_FREERTOS=y
CONFIG_LV_USE_FREERTOS_TASK_NOTIFY=y
CONFIG_LV_USE_CLIB_MALLOC=y
CONFIG_LV_USE_CLIB_STRING=y
CONFIG_LV_USE_CLIB_SPRINTF=y
CONFIG_LV_DEF_REFR_PERIOD=10
CONFIG_LV_OBJ_STYLE_CACHE=y
CONFIG_LV_DRAW_SW_SUPPORT_RGB565=y
CONFIG_LV_DRAW_SW_SUPPORT_RGB565_SWAPPED=y
# QR code and text rendering require I1/A8; custom dashboard canvases require
# ARGB8888. Other software pixel formats are not used by the product.
# CONFIG_LV_DRAW_SW_SUPPORT_RGB565A8 is not set
# CONFIG_LV_DRAW_SW_SUPPORT_RGB888 is not set
# CONFIG_LV_DRAW_SW_SUPPORT_XRGB8888 is not set
CONFIG_LV_DRAW_SW_SUPPORT_ARGB8888=y
# CONFIG_LV_DRAW_SW_SUPPORT_ARGB8888_PREMULTIPLIED is not set
# CONFIG_LV_DRAW_SW_SUPPORT_L8 is not set
# CONFIG_LV_DRAW_SW_SUPPORT_AL88 is not set
CONFIG_LV_DRAW_SW_SUPPORT_A8=y
CONFIG_LV_DRAW_SW_SUPPORT_I1=y
CONFIG_LV_FONT_MONTSERRAT_14=y
CONFIG_LV_FONT_MONTSERRAT_24=y
CONFIG_LV_FONT_MONTSERRAT_28=y
CONFIG_LV_FONT_MONTSERRAT_48=y
CONFIG_LV_FONT_DEFAULT_MONTSERRAT_14=y
CONFIG_LV_USE_LABEL=y
CONFIG_LV_USE_CANVAS=y
CONFIG_LV_USE_DROPDOWN=y
CONFIG_LV_USE_LINE=y
CONFIG_LV_USE_IMAGE=y
CONFIG_LV_USE_QRCODE=y
CONFIG_ESP_BMS_LVGL_BRIDGE_SPI_DRAW_BUFFER_HEIGHT=40
CONFIG_ESP_BMS_LVGL_BRIDGE_TASK_MAX_DELAY_MS=5
# CONFIG_ESP_BMS_LVGL_BRIDGE_DOUBLE_BUFFER is not set
CONFIG_ESP_BMS_LVGL_UI_DRAG_FULL_INVALIDATE=y
# CONFIG_ESP_BMS_LVGL_UI_DRAG_DIAGNOSTICS is not set
# CONFIG_ESP_BMS_LVGL_UI_DRAG_SAMPLE_DIAGNOSTICS is not set

# Keep the IDF display bring-up image small and focused.
# CONFIG_LV_BUILD_EXAMPLES is not set
# CONFIG_LV_BUILD_DEMOS is not set
# CONFIG_ESP_LVGL_ADAPTER_ENABLE_FS is not set
# CONFIG_ESP_LVGL_ADAPTER_ENABLE_DECODER is not set
# CONFIG_ESP_LVGL_ADAPTER_ENABLE_FREETYPE is not set
# CONFIG_ESP_LVGL_ADAPTER_ENABLE_BUTTON is not set
# CONFIG_ESP_LVGL_ADAPTER_ENABLE_KNOB is not set
CONFIG_HTTPD_WS_SUPPORT=y
```

## sdkconfig.defaults.dragdiag
```kconfig
# Overlay for an LVGL drag diagnostic image. Use with:
#   ./scripts/esp-idf-drag-diag.sh build

CONFIG_ESP_BMS_LVGL_UI_DRAG_DIAGNOSTICS=y
CONFIG_ESP_BMS_LVGL_UI_DRAG_SAMPLE_DIAGNOSTICS=y
CONFIG_ESP_BMS_LVGL_UI_DRAG_SAMPLE_PERIOD_MS=100
```

## sdkconfig.defaults.dragdiag-double-buffer
```kconfig
# Optional overlay for LVGL drag diagnostics with a second SPI draw buffer.
# Use only after normal diagnostic boot logs show enough dma_free/dma_largest.

CONFIG_ESP_BMS_LVGL_BRIDGE_DOUBLE_BUFFER=y
```

## sdkconfig.defaults.dragdiag-no-full-invalidate
```kconfig
# Overlay for comparing LVGL native partial invalidation against the normal
# full-dashboard invalidation path during drag diagnostics.

# CONFIG_ESP_BMS_LVGL_UI_DRAG_FULL_INVALIDATE is not set
```
